## Documentation/devicetree/bindings/perf/brcm,bcm5301x-axi-pmu.yaml
```yaml
# SPDX-License-Identifier: (GPL-2.0-only OR BSD-2-Clause)
%YAML 1.2
---
$id: http://devicetree.org/schemas/perf/brcm,bcm5301x-axi-pmu.yaml#
$schema: http://devicetree.org/meta-schemas/core.yaml#

title: Broadcom BCM5301X AXI Trace Module performance monitor

maintainers:
  - Florian Fainelli <florian.fainelli@broadcom.com>

description: |
  The BCM5301X ARM subsystem contains three AXI Trace Modules, monitoring the
  two PL310 AXI master interfaces and the Accelerator Coherency Port (ACP).
  Each module has its own APB register window and fixed performance counters
  for commands, data beats, channel activity and stalls, latency, and cycles
  with outstanding commands. Counters support local start, stop, and clear
  commands. No counter overflow interrupt is provided.

  Each node describes one module. The separate ATB trace output and its
  CoreSight connections are outside the scope of this binding. This block
  is distinct from the BCM2835 family AXI bus-watcher performance monitor.

properties:
  compatible:
    const: brcm,bcm5301x-axi-pmu

  reg:
    maxItems: 1
    description: APB register window of one AXI Trace Module.

required:
  - compatible
  - reg

additionalProperties: false

examples:
  - |
    pmu@19003000 {
        compatible = "brcm,bcm5301x-axi-pmu";
        reg = <0x19003000 0x1000>;
    };
```
